## boards/arm/babbies_tracker/Kconfig.babbies_tracker
```kconfig
# Copyright (c) 2019 Nordic Semiconductor ASA
# SPDX-License-Identifier: LicenseRef-Nordic-5-Clause

config BOARD_BABBIES_TRACKER
	select SOC_NRF52840_QIAA if BOARD_BABBIES_TRACKER_NRF52840
	select SOC_NRF9160_SICA if BOARD_BABBIES_TRACKER_NRF9160 || BOARD_BABBIES_TRACKER_NRF9160_NS
```

## boards/arm/babbies_tracker/Kconfig.mcuboot
```kconfig
choice BOOT_SIGNATURE_TYPE
	default BOOT_SIGNATURE_TYPE_RSA if BABBIES_TRACKER_STATIC_PARTITIONS_FACTORY
	default BOOT_SIGNATURE_TYPE_ED25519 if SOC_SERIES_NRF54LX || SOC_SERIES_NRF54HX
	default BOOT_SIGNATURE_TYPE_ECDSA_P256 if ((SOC_NRF52840 || SOC_SERIES_NRF91X) && !BOARD_BABBIES_TRACKER_NRF9160 && !BOARD_BABBIES_TRACKER_NRF52840)
	default BOOT_SIGNATURE_TYPE_ECDSA_P256 if SECURE_BOOT_APPCORE
```

## boards/arm/babbies_tracker/board.yml
```yaml
board:
  name: babbies_tracker
  vendor: iomico
  socs:
    - name: nrf52840
    - name: nrf9160
      variants:
        - name: ns
```

## boards/arm/babbies_tracker/dts/bindings/iomico,babbies_tracker-nrf52840-reset.yaml
```yaml
# Copyright (c) 2021 Nordic Semiconductor ASA
# SPDX-License-Identifier: LicenseRef-Nordic-5-Clause

description: GPIO used to reset nRF52840 on BabbiesTracker board

compatible: "iomico,babbies_tracker-nrf52840-reset"

include: base.yaml

properties:
  status:
    required: true

  gpios:
    type: phandle-array
    required: true
    description: |
      GPIO to use as nRF52840 reset line: output in nRF9160, input in nRF52840.
```

## custom_modules/drivers/sensor/our_bme680/Kconfig
```kconfig
menuconfig OUR_BME680
	bool "OUR_BME680 sensor"
	default y
	depends on DT_HAS_OUR_BME680_ENABLED
	select I2C if $(dt_compat_on_bus,$(DT_COMPAT_OUR_BME680),i2c)
	select SPI if $(dt_compat_on_bus,$(DT_COMPAT_OUR_BME680),spi)
	help
	  Enable driver for BME680 I2C- or SPI- based temperature, pressure, humidity and gas sensor.

if OUR_BME680

choice OUR_BME680_TEMP_OVERSAMPLING
	prompt "BME680 temperature oversampling"
	default OUR_BME680_TEMP_OVER_2X
	help
	  Select temperature oversampling for the BME680 sensor.  Higher values
	  lead to more accurate readings, but higher power consumption.
config OUR_BME680_TEMP_OVER_1X
	bool "x1"
config OUR_BME680_TEMP_OVER_2X
	bool "x2"
config OUR_BME680_TEMP_OVER_4X
	bool "x4"
config OUR_BME680_TEMP_OVER_8X
	bool "x8"
config OUR_BME680_TEMP_OVER_16X
	bool "x16"
endchoice

choice OUR_BME680_PRESS_OVERSAMPLING
	prompt "BME680 pressure oversampling"
	default OUR_BME680_PRESS_OVER_16X
	help
	  Select pressure oversampling for the BME680 sensor.  Higher values
	  lead to more accurate readings, but higher power consumption.
config OUR_BME680_PRESS_OVER_1X
	bool "x1"
config OUR_BME680_PRESS_OVER_2X
	bool "x2"
config OUR_BME680_PRESS_OVER_4X
	bool "x4"
config OUR_BME680_PRESS_OVER_8X
	bool "x8"
config OUR_BME680_PRESS_OVER_16X
	bool "x16"
endchoice

choice OUR_BME680_HUMIDITY_OVERSAMPLING
	prompt "BME680 humidity oversampling"
	default OUR_BME680_HUMIDITY_OVER_1X
	help
	  Select humidity oversampling for the BME680 sensor.  Higher values
	  lead to more accurate readings, but higher power consumption.
config OUR_BME680_HUMIDITY_OVER_1X
	bool "x1"
config OUR_BME680_HUMIDITY_OVER_2X
	bool "x2"
config OUR_BME680_HUMIDITY_OVER_4X
	bool "x4"
config OUR_BME680_HUMIDITY_OVER_8X
	bool "x8"
config OUR_BME680_HUMIDITY_OVER_16X
	bool "x16"
endchoice

choice OUR_BME680_FILTER_COEFFICIENT
	prompt "BME680 IIR low-pass filter coefficient"
	default OUR_BME680_FILTER_OFF
	help
	  Select the filter coefficient for the BME680 sensor.
config OUR_BME680_FILTER_OFF
	bool "filter off"
config OUR_BME680_FILTER_2
	bool "2"
config OUR_BME680_FILTER_4
	bool "4"
config OUR_BME680_FILTER_8
	bool "8"
config OUR_BME680_FILTER_16
	bool "16"
config OUR_BME680_FILTER_32
	bool "32"
config OUR_BME680_FILTER_64
	bool "64"
config OUR_BME680_FILTER_128
	bool "128"
endchoice

choice OUR_BME680_HEATR_TEMP
	prompt "BME680 gas sensor's heater temperature in degree Celsius"
	default OUR_BME680_HEATR_TEMP_LP
	help
	  Select the gas sensor's heater temperature for the BME680 sensor.
config OUR_BME680_HEATR_TEMP_LP
	bool "320"
config OUR_BME680_HEATR_TEMP_ULP
	bool "400"
endchoice

choice OUR_BME680_HEATR_DUR
	prompt "BME680 gas sensor's heating duration in milliseconds"
	default OUR_BME680_HEATR_DUR_LP
	help
	  Select the gas sensor's heating duration for the BME680 sensor.
config OUR_BME680_HEATR_DUR_LP
	bool "197"
config OUR_BME680_HEATR_DUR_ULP
	bool "1943"
endchoice

endif # OUR_BME680
```

## custom_modules/dts/bindings/sensor/our,bme680.yaml
```yaml
# This file describes the hardware interface for your driver.
# Zephyr uses this to validate the device tree and generate macros.

description:
  My custom BME680 driver binding.
  The BME680 is an environmental sensor for temperature, humidity, pressure, and gas quality.

# This matches the 'compatible' string in your .overlay file
compatible: "our,bme680"

# Inherit standard I2C properties (like 'reg' for the address)
include: [sensor-device.yaml, i2c-device.yaml]

# properties:
    # You can add custom properties here later, for example:
    # gas-heater-default-temp:
    #   type: int
    #   description: Default temp in C for the heater
```
